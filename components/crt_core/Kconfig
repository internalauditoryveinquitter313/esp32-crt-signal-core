## components/crt_core/Kconfig
```kconfig
menu "CRT Core"

choice CRT_VIDEO_STANDARD
    prompt "Composite video standard"
    default CRT_VIDEO_STANDARD_NTSC
    help
        Select the composite timing profile used by the CRT core.

config CRT_VIDEO_STANDARD_NTSC
    bool "NTSC"

config CRT_VIDEO_STANDARD_PAL
    bool "PAL"

endchoice

config CRT_ENABLE_COLOR
    bool "Enable composite color burst"
    default y
    help
        Enables chroma burst generation and color demo output.
        Disable this to force monochrome output mode.

choice CRT_RENDER_MODE
    prompt "Demo render mode"
    default CRT_RENDER_MODE_COMPOSE
    help
        Select the app_main rendering path used for on-device bring-up.

config CRT_RENDER_MODE_COMPOSE
    bool "Tile compositor with grayscale DAC palette"

config CRT_RENDER_MODE_RGB332_FB
    bool "Direct RGB332 framebuffer"
    depends on CRT_ENABLE_COLOR
    help
        Uses the ESP_8_BIT-derived RGB332 composite color tables to render
        a 256x240 framebuffer directly, bypassing the tile compositor.

config CRT_RENDER_MODE_STIMULUS
    bool "Measurement stimulus compositor"
    help
        Uses crt_stimulus as an opaque compositor base layer to emit
        deterministic ramps, markers, PRBS, impulse, and chirp patterns for
        capture-card/CRT measurement loops.

endchoice

config CRT_ENABLE_UART_UPLOAD
    bool "Enable UART framebuffer upload"
    default n
    help
        Enables the experimental UART0 raw framebuffer upload protocol used
        by tools/crt_monitor. Keep this disabled for timing-stability runs
        because bulk UART transfers can contend with the realtime pipeline.

config CRT_TEST_STANDARD_TOGGLE
    bool "Test mode: auto-toggle NTSC/PAL"
    default n
    help
        Automatically alternates between NTSC and PAL at runtime.
        Useful for CRT compatibility testing.

config CRT_TEST_STANDARD_TOGGLE_INTERVAL_S
    int "Test mode toggle interval (seconds)"
    depends on CRT_TEST_STANDARD_TOGGLE
    range 1 120
    default 5
    help
        Number of seconds to keep each video standard before toggling.

endmenu
```

## sdkconfig.defaults
```kconfig
# ESP32 CRT Signal Core — sdkconfig overrides
# Only non-default values go here. Everything else uses ESP-IDF defaults.
# Run `idf.py menuconfig` to explore, then extract changes here.

# ── CPU ──────────────────────────────────────────────────────────────
CONFIG_ESP_DEFAULT_CPU_FREQ_MHZ=240

# ── Flash ────────────────────────────────────────────────────────────
CONFIG_ESPTOOLPY_FLASHSIZE="4MB"
CONFIG_ESPTOOLPY_FLASHFREQ="40m"
CONFIG_ESPTOOLPY_FLASHMODE="dio"

# ── FreeRTOS ─────────────────────────────────────────────────────────
CONFIG_FREERTOS_HZ=1000

# ── Watchdog — prep task on Core 1 can be tight ─────────────────────
CONFIG_ESP_TASK_WDT_TIMEOUT_S=10

# ── Compiler ─────────────────────────────────────────────────────────
CONFIG_COMPILER_OPTIMIZATION_PERF=y

# ── Log level ────────────────────────────────────────────────────────
CONFIG_LOG_DEFAULT_LEVEL=3

# ── CRT Signal Core ──────────────────────────────────────────────────
CONFIG_CRT_VIDEO_STANDARD_NTSC=y
CONFIG_CRT_ENABLE_COLOR=y
CONFIG_CRT_TEST_STANDARD_TOGGLE=n
```
